## board/cvitek/cv184x/Kconfig
```kconfig
if TARGET_CVITEK_CV184X

choice
	prompt "Cvitek CV184X verification platform type select"

config TARGET_CVITEK_CV184X_ASIC
	bool "ASIC"
	help
	  This enables support for Cvitek's CV184X SoC on ASIC platform.

	  If unsure, say N.

config TARGET_CVITEK_CV184X_PALLADIUM
	bool "Palladium"
	help
	  This enables support for Cvitek's CV184X SoC on PALLADIUM platform.

	  If unsure, say N.

config TARGET_CVITEK_CV184X_FPGA
	bool "FPGA"
	help
	  This enables support for Cvitek's CV184X SoC on FPGA platform.

	  If unsure, say N.

endchoice

config SYS_BOARD
	default "cv184x"

config SYS_VENDOR
	default "cvitek"

config SYS_CPU
	default "generic"

config SYS_CONFIG_NAME
	default "cv184x-asic" if TARGET_CVITEK_CV184X_ASIC
	default "cv184x-palladium" if TARGET_CVITEK_CV184X_PALLADIUM
	default "cv184x-fpga" if TARGET_CVITEK_CV184X_FPGA

config CVITEK_SPI_FLASH
    bool
	prompt "Support CVITEK SPINOR"
    select SPI_FLASH
	select DM
	select DM_SPI
	select DM_SPI_FLASH
	select SPI_MEM
	select CMD_SF
    select CVI_SPIF

config ENV_SIZE
    default 0x10000 if ENV_IS_IN_SPI_FLASH
    default 0x20000 if ENV_IS_IN_MMC
	default 0x20000 if ENV_IS_IN_NAND

config ENV_SECT_SIZE
	default 0x10000 if ENV_IS_IN_SPI_FLASH
	default 0x40000 if ENV_IS_IN_MMC
	default 0x20000 if ENV_IS_IN_NAND

config ENV_OFFSET
    default 0x3A0000 if ENV_IS_IN_SPI_FLASH
    default 0x880000 if ENV_IS_IN_MMC
	default 0xae0000 if ENV_IS_IN_NAND

config ENV_OFFSET_REDUND
    default 0x3B0000 if ENV_IS_IN_SPI_FLASH
	default 0xb00000 if ENV_IS_IN_NAND

endif
```

## board/cvitek/cv84x6/Kconfig
```kconfig
if TARGET_CVITEK_CV84X6

choice
	prompt "Cvitek CV84X6 verification platform type select"

config TARGET_CVITEK_CV84X6_ASIC
	bool "ASIC"
	help
	  This enables support for Cvitek's CV84X6 SoC on ASIC platform.

	  If unsure, say N.

config TARGET_CVITEK_CV84X6_PALLADIUM
	bool "Palladium"
	help
	  This enables support for Cvitek's CV84X6 SoC on PALLADIUM platform.

	  If unsure, say N.

config TARGET_CVITEK_CV84X6_FPGA
	bool "FPGA"
	help
	  This enables support for Cvitek's CV84X6 SoC on FPGA platform.

	  If unsure, say N.

endchoice

config SYS_BOARD
	default "cv84x6"

config SYS_VENDOR
	default "cvitek"

config SYS_CPU
	default "generic"

config ROOTFS_UBUNTU
	bool "Enable ubuntu file system"
	default n
	help
	  Enable ubuntu file system.

config ROOTFS_DEBIAN
	bool "Enable debian file system"
	default n
	help
	  Enable debian file system.

config SYS_CONFIG_NAME
	default "cv84x6-asic" if TARGET_CVITEK_CV84X6_ASIC
	default "cv84x6-palladium" if TARGET_CVITEK_CV84X6_PALLADIUM
	default "cv84x6-fpga" if TARGET_CVITEK_CV84X6_FPGA

config CVITEK_SPI_FLASH
    bool
	prompt "Support CVITEK SPINOR"
    select SPI_FLASH
	select DM
	select DM_SPI
	select DM_SPI_FLASH
	select SPI_MEM
	select CMD_SF
    select CVI_SPIF

config ENV_SIZE
    default 0x10000 if ENV_IS_IN_SPI_FLASH
    default 0x20000 if ENV_IS_IN_MMC
	default 0x20000 if ENV_IS_IN_NAND

config ENV_SECT_SIZE
	default 0x10000 if ENV_IS_IN_SPI_FLASH
	default 0x40000 if ENV_IS_IN_MMC
	default 0x20000 if ENV_IS_IN_NAND

config ENV_OFFSET
    default 0x3A0000 if ENV_IS_IN_SPI_FLASH
    default 0x880000 if ENV_IS_IN_MMC
	default 0xae0000 if ENV_IS_IN_NAND

config ENV_OFFSET_REDUND
    default 0x3B0000 if ENV_IS_IN_SPI_FLASH
	default 0xb00000 if ENV_IS_IN_NAND

endif
```

## drivers/crypto/Kconfig
```kconfig
menu "Hardware crypto devices"

source drivers/crypto/fsl/Kconfig

config SOPHON_SPACC
        bool "sophon spacc for aes/sha"
        help
          Select Crypto driver for sophon platfromd

endmenu
```
